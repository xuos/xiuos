## board/ok1052-c/Kconfig
```kconfig
mainmenu "XiUOS Project Configuration"

config BSP_DIR
    string
    option env="BSP_ROOT"
    default "."

config KERNEL_DIR
    string
    option env="KERNEL_ROOT"
    default "../.."

config BOARD_CORTEX_M7_EVB
    bool
    select  ARCH_ARM
    default y


source "$KERNEL_DIR/arch/Kconfig"

menu "ok1052-c feature"
    source "$BSP_DIR/third_party_driver/Kconfig"

    menu "config default board resources"
        menu "config board app name"
            config BOARD_APP_NAME
                string "config board app name"
                default "/XiUOS_ok1052C_app.bin"
        endmenu

        menu "config board service table"
            config SERVICE_TABLE_ADDRESS
                hex "board service table address"
                default 0x2007F0000
        endmenu

    endmenu

    config __STACKSIZE__
        int "stack size for interrupt"
        default 4096

endmenu


menu "Hardware feature"
source "$KERNEL_DIR/resources/Kconfig"
endmenu

source "$KERNEL_DIR/Kconfig"
```

## board/stm32f407-st-discovery/third_party_driver/gpio/Kconfig
```kconfig
config PIN_BUS_NAME
    string "pin bus name"
    default "pin"

config PIN_DRIVER_NAME
    string "pin driver name"
    default "pin_drv"

config PIN_DEVICE_NAME
    string "pin device name"
    default "pin_dev"
```
