## Ubiquitous/XiUOS/framework/intelligent/Kconfig
```kconfig
menu "Intelligence"

source "$KERNEL_DIR/framework/intelligent/tflite-mcu/Kconfig"

endmenu
```

## Ubiquitous/XiUOS/framework/security/Kconfig
```kconfig
menu "Security"

menuconfig CRYPTO
    bool "using crypto"
    default n
if CRYPTO
    menuconfig CRYPTO_SM3
        bool "using sm3"
        default n

    menuconfig CRYPTO_SM4
        bool "using sm4"
        default n

    menuconfig CRYPTO_SM9
        select CRYPTO_SM3
        select CRYPTO_SM4
        bool "using sm9"

        default n
endif

endmenu
```

## Ubiquitous/XiUOS/fs/iot-devicefile/Kconfig
```kconfig
    config VFS_USING_WORKDIR
    bool "Using work dir for FS_VFS"
    default y
    config FS_VFS_DEVFS
    bool "Using dev object for FS_VFS"
    default y
```

## Ubiquitous/XiUOS/kernel/Kconfig
```kconfig
menu "Kernel feature"
    menu "separate compile(choose none for compile once)"
        config SEPARATE_COMPILE
        bool
        default n

        config COMPILER_APP
            bool "only compile application"
            default n
            select USER_APPLICATION
            select SEPARATE_COMPILE
            choice 
                prompt "select the startup site of APP "
                default APP_STARTUP_FROM_FLASH

                config APP_STARTUP_FROM_SDCARD
                    bool "app start from sd card"

                config APP_STARTUP_FROM_FLASH
                    bool "app start from flash"
            endchoice
            

        config COMPILER_KERNEL
            bool "only compile kernel"
            default n
            select SEPARATE_COMPILE
    endmenu

    menu "Memory Management"
        config KERNEL_MEMBLOCK
            bool "Using gather block"
            default n
        config MEM_ALIGN_SIZE
            int "Alignment size for CPU architecture data access"
            default 8
            help
                Alignment size for CPU architecture data access

        config MEM_EXTERN_SRAM
            bool "Using extern memory"
            default n

        config MM_PAGE_SIZE
            int "Config memory page size"
            default 4096
            help
               config memory page size
        menu "Using small memory allocator"
            config KERNEL_SMALL_MEM_ALLOC
               bool "Using small memory allocator"
               default y
            if KERNEL_SMALL_MEM_ALLOC
            config SMALL_NUMBER_32B
                int "Config 32B small memory number"
                range 1 256
                default 64
            config SMALL_NUMBER_64B
                int "Config 64B small memory number"
                range 1 128
                default 32
            endif
        endmenu
    endmenu

    menu "Task feature"
        config USER_APPLICATION
            bool "start system application"
            default y

        config  TASK_ISOLATION
            bool "Enable task isolation"
            default n
            select SEPARATE_COMPILE
            select COMPILER_APP
            select COMPILER_KERNEL
            help
                Enable task isolation

        menu "Inter-Task communication"
            config KERNEL_SEMAPHORE
                bool "Enable semaphore"
                default y

            config KERNEL_MUTEX
                bool "Enable mutex"
                default y

            config KERNEL_EVENT
                bool "Enable event"
                default y

            config KERNEL_MESSAGEQUEUE
                bool "Enable message queue"
                default y

            config KERNEL_SOFTTIMER
                bool "Enable softtimer "
                select KERNEL_WORKQUEUE
                default y
        endmenu

        choice 
            prompt "Scheduler Policy Set"
            default SCHED_POLICY_RR_REMAINSLICE

            config SCHED_POLICY_RR_REMAINSLICE
                bool "config scheduler policy as RR REMAINSLICE"

            config SCHED_POLICY_RR
                bool "config scheduler policy as RR "

            config SCHED_POLICY_FIFO
                bool "config scheduler policy as FIFO"
        endchoice

        choice
            prompt "The maximal level value of priority of task"
            default KTASK_PRIORITY_32

            config KTASK_PRIORITY_8
                bool "8"

            config KTASK_PRIORITY_32
                bool "32"

            config KTASK_PRIORITY_256
                bool "256"
        endchoice

    config KTASK_PRIORITY_MAX
        int
        default 8   if KTASK_PRIORITY_8
        default 32  if KTASK_PRIORITY_32
        default 256 if KTASK_PRIORITY_256

    config TICK_PER_SECOND
        int "Tick frequency, Hz"
        range 10 1000
        default 100
        help
            System's tick frequency, Hz.

    config KERNEL_STACK_OVERFLOW_CHECK
        bool "Using stack overflow checking"
        default y
        help
            Enable task stack overflow checking. The stack overflow is checking when
            each task switch.

    config IDLE_KTASK_STACKSIZE
        int "The stack size of idle task"
        default 1024

    config ZOMBIE_KTASK_STACKSIZE
        int "The stack size of zombie_recycle task"
        default 2048

    endmenu
    
    menu "Kernel Console"
        config KERNEL_CONSOLE
            bool "config enable console"
            default y

        if KERNEL_CONSOLE
            config KERNEL_BANNER
                bool "config system banner print"
                default y

            config KERNEL_CONSOLEBUF_SIZE
                int "default buffer size for console log printf"
                default 128
        endif
    endmenu

    menu "Kernel Hook"
        menuconfig KERNEL_HOOK
            bool "Enable system hook"
            default n
            help
                Enable the hook function when system running, such as idle task hook,
                task context switch etc.

            if KERNEL_HOOK
                menuconfig KERNEL_IDLE_HOOK
                    bool "Enable IDLE Task hook"
                    default y 

                if KERNEL_IDLE_HOOK
                    config IDEL_HOOK_LIST_SIZE
                        int "The max size of idle hook list"
                        default 4
                        range 1 16
                        help
                            The system has a hook list. This is the hook list size.
                endif
            endif
    endmenu

    source "$KERNEL_DIR/tool/shell/Kconfig"

    menu "Kernel data structure Manage"
        menuconfig KERNEL_QUEUEMANAGE
            bool "Config Kernel Queue Manage"
            default y

            if KERNEL_QUEUEMANAGE
                config KERNEL_WORKQUEUE
                    bool "Config kernel work queue"
                    default y

                    if KERNEL_WORKQUEUE
                        config WORKQUEUE_KTASK_STACKSIZE
                            int "The stack size for workqueue task"
                            default 2048

                        config WORKQUEUE_KTASK_PRIORITY
                                int
                                default 6  if KTASK_PRIORITY_8
                                default 23  if KTASK_PRIORITY_32
                                default 128  if KTASK_PRIORITY_256
                        config QUEUE_MAX
                                int "Config the max queue length"
                                default 16
                    endif
                
                config KERNEL_WAITQUEUE
                    bool "Config kernel wait queue"
                    default y

                config KERNEL_DATAQUEUE
                    bool "Config kernel data queue"
                    default y
            endif

        config KERNEL_CIRCULAR_AREA
        bool "Config Kernel Circular Area"
        default n

        config KERNEL_AVL_TREE
        bool "Config Kernel AVL Tree"
        default n
    endmenu

    menu "Kernel components init"
        menuconfig KERNEL_COMPONENTS_INIT
            bool "Use components automatically initialization"
            default y

            if KERNEL_COMPONENTS_INIT
                config ENV_INIT_KTASK_STACK_SIZE
                    int "Set env init task stack size"
                    default 8192

                menuconfig KERNEL_USER_MAIN
                    bool "The main() function as user entry function"
                    default y
            endif
    endmenu

    config NAME_NUM_MAX
        int "The maximal size of kernel object name"
        range 2 32
        default 32
        help
            Each kernel object, such as task has a name,
            the NAME_NUM_MAX is the maximal size of this name.

    menuconfig KERNEL_DEBUG
        bool "Enable debugging features"
        default n

        if KERNEL_DEBUG
            config DEBUG_INIT_CONFIG
                bool "Enable debugging of components initialization"
                default y

            config KDYN_LOG_DBG
                bool "Enable DYNAMIC [DBG] LOG"
                default y

            config DBG_INIT
                int
                default 1 if DEBUG_INIT_CONFIG
        endif

    menuconfig ARCH_SMP
        bool "Enable SMP(Symmetric multiprocessing)"
        default n
        help
            This option should be selected by machines which have an SMP-
            capable CPU.
            The only effect of this option is to make the SMP-related
            options available to the user for configuration.

        config CPU_NUMBERS
        int "Number of CPUs"
        default 2
        depends on ARCH_SMP
        help
            Number of CPUs in the system
    menu "hash table config"
        menuconfig ID_HTABLE_SIZE
            int "ID hash table size"
            range 1 256
            default 16
            help
                Size of the hash table that ID manager uses internally
        menuconfig ID_NUM_MAX
            int "ID num max"
            range 16 256
            default 128
            help
                max num of the ID manager
    endmenu
    

source "$KERNEL_DIR/kernel/kernel_test/Kconfig"

endmenu
```

## Ubiquitous/XiUOS/lib/Kconfig
```kconfig
menu "Lib"



menuconfig LIB
    bool "Enable libc APIs from toolchain"
    default y


    if LIB 
        config LIB_POSIX
            bool "Enable POSIX layer for poll/select, stdin etc"
            default y
    endif




source "$KERNEL_DIR/lib/libcpp/Kconfig"

source "$KERNEL_DIR/lib/newlib/Kconfig"

endmenu
```

## Ubiquitous/XiUOS/lib/libcpp/Kconfig
```kconfig
menu "C++ features"

config  LIB_CPLUSPLUS
    bool "Support C++ features"
    default n

endmenu
```

## Ubiquitous/XiUOS/resources/Kconfig
```kconfig
menuconfig RESOURCES_SERIAL
    bool "Using SERIAL bus drivers"
    select KERNEL_WORKQUEUE
    default y

if RESOURCES_SERIAL
    config SERIAL_USING_DMA
        bool "Enable SERIAL DMA mode"
        default y

    config SERIAL_RB_BUFSZ
        int "Set SERIAL RX buffer size"
        default 128
endif

if BSP_USING_CAN
    config RESOURCES_CAN
        bool "Using CAN bus drivers"
        default y
endif

if BSP_USING_I2C
    config RESOURCES_I2C
        bool "Using I2C bus drivers"
        default n
endif

if BSP_USING_LCD
    config RESOURCES_LCD
        bool "Using LCD bus drivers"
        default n
endif

if BSP_USING_GPIO
    config RESOURCES_PIN
        bool "Using generic GPIO PIN bus drivers"
        default n
endif

if BSP_USING_RTC
    menuconfig RESOURCES_RTC
        bool "Using RTC bus drivers"
        default n

        if RESOURCES_RTC
            config USING_SOFT_RTC
            bool "Using SOFT RTC"
            default n
            if USING_SOFT_RTC
                config SOFT_RTC_BUS_NAME
                    string "soft rtc bus name"
                    default "srtc"
                config SOFT_RTC_DRV_NAME
                    string "soft rtc bus driver name"
                    default "srtc_drv"  
            endif
        endif
endif

if BSP_USING_SDIO
    config RESOURCES_SDIO
        bool "Using SD/MMC card bus drivers"
        default n
endif

if BSP_USING_SPI
    menuconfig RESOURCES_SPI
        bool "Using SPI bus drivers"
        default n

        if RESOURCES_SPI  
            menuconfig RESOURCES_SPI_SD
                bool "Using SD/TF card driver with spi"
                    default n
                if RESOURCES_SPI_SD
                    config SPI_SD_NAME
                    string "spi sd card 0 name"
                    default "sd0"
                endif

            menuconfig RESOURCES_SPI_SFUD
                bool "Using Serial Flash Universal Driver Lib"
                default n
                if RESOURCES_SPI_SFUD
                    config SFUD_USING_SFDP
                    bool "Using auto probe flash JEDEC SFDP parameter"
                    default y

                    config SFUD_USING_FLASH_INFO_TABLE
                    bool "Using defined supported flash chip information table"
                    default n
                    
                    config SFUD_DEBUG_LOG
                    bool "Support SFUD debug log"
                    default y
                endif
        endif
endif

if BSP_USING_HWTIMER
    config RESOURCES_HWTIMER
        bool "Using hardware timer bus drivers"
        default n
endif

if BSP_USING_TOUCH
    config RESOURCES_TOUCH
        bool "Using touch bus drivers"
        default n
endif

if BSP_USING_USB
    menuconfig RESOURCES_USB
        bool "Using USB bus drivers"
        default n
        
    if RESOURCES_USB
        config RESOURCES_USB_HOST
            bool "Using USB host function"
            default y
            if RESOURCES_USB_HOST
                    config UDISK_MOUNTPOINT
                        string "Udisk mount dir"
                        default "/"
            endif
                    config USBH_MSTORAGE
                        bool "usb use mass storage device"
                        default y
                        select FS_VFS

        config RESOURCES_USB_DEVICE
            bool "Using USB device function"
            default y
            
            if RESOURCES_USB_DEVICE
                config USBD_THREAD_STACK_SZ
                    int "usb thread stack size"
                    default 4096
            endif
    endif
endif

if BSP_USING_LWIP
    config RESOURCES_LWIP
        bool "Using LwIP bus drivers"
        default n
endif

if BSP_USING_WDT
    config RESOURCES_WDT
        bool "Using Watch Dog bus drivers"
        default n
endif
```

## applications/app_test/Kconfig
```kconfig
menuconfig USER_TEST
    bool "Enable application test function "
    default n

    if USER_TEST
        config USER_TEST_LORA_ADHOC
            bool "Config test lora adhoc"
            default n

        config USER_TEST_SPI_LORA
            bool "Config test spi lora"
            default n

        config USER_TEST_SPI_FLASH
            bool "Config test spi flash"
            default n

    endif
```

## applications/tflite_mnist/Kconfig
```kconfig
config USING_TFLITE_MNIST
    bool "mnist demo app for tflite micro"
    depends on INTELLIGENT_TFLITE
    default n
```
