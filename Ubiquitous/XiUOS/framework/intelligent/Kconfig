## board/aiit-arm32-board/third_party_driver/Kconfig
```kconfig
menuconfig BSP_USING_CH438
bool "Using CH438 device"
default y
if BSP_USING_CH438
source "$BSP_DIR/third_party_driver/ch438/Kconfig"
endif

menuconfig BSP_USING_DMA
bool "Using DMA device"
default y
if BSP_USING_DMA
source "$BSP_DIR/third_party_driver/common/Kconfig"
endif

menuconfig BSP_USING_EXTMEM
bool "Using EXTMEM device"
default n
if BSP_USING_EXTMEM
source "$BSP_DIR/third_party_driver/extmem/Kconfig"
endif

menuconfig BSP_USING_GPIO
bool "Using GPIO device "
default y
select RESOURCES_PIN
if BSP_USING_GPIO
source "$BSP_DIR/third_party_driver/gpio/Kconfig"
endif

menuconfig BSP_USING_I2C
bool "Using I2C device"
default n
select RESOURCES_I2C
if BSP_USING_I2C
source "$BSP_DIR/third_party_driver/i2c/Kconfig"
endif

menuconfig BSP_USING_LCD
bool "Using LCD device"
default n
select RESOURCES_LCD
select BSP_USING_SPI1
if BSP_USING_LCD
source "$BSP_DIR/third_party_driver/lcd/Kconfig"
endif

menuconfig BSP_USING_RTC
bool "Using RTC device"
default n
select RESOURCES_RTC
if BSP_USING_RTC
source "$BSP_DIR/third_party_driver/rtc/Kconfig"
endif

menuconfig BSP_USING_SDIO
bool "Using SDIO device"
default n
select RESOURCES_SDIO
if BSP_USING_SDIO
source "$BSP_DIR/third_party_driver/sdio/Kconfig"
endif

menuconfig BSP_USING_SPI
bool "Using SPI device"
default n
select RESOURCES_SPI
select BSP_USING_DMA
if BSP_USING_SPI
source "$BSP_DIR/third_party_driver/spi/Kconfig"
endif

menuconfig BSP_USING_HWTIMER
bool "Using HWTIMER device"
default n
select RESOURCES_HWTIMER
if BSP_USING_HWTIMER
source "$BSP_DIR/third_party_driver/timer/Kconfig"
endif

menuconfig BSP_USING_TOUCH
bool "Using TOUCH device"
default n
select RESOURCES_TOUCH
if BSP_USING_TOUCH
source "$BSP_DIR/third_party_driver/touch/Kconfig"
endif

menuconfig BSP_USING_UART
bool "Using UART device"
default y
select RESOURCES_SERIAL
if BSP_USING_UART
source "$BSP_DIR/third_party_driver/uart/Kconfig"
endif




menuconfig BSP_USING_CAN
bool "Using CAN device"
default n
select RESOURCES_CAN
if BSP_USING_CAN
source "$BSP_DIR/third_party_driver/can/Kconfig"
endif

menuconfig BSP_USING_USB
bool "Using USB device"
default n
select BSP_USING_USBH
select RESOURCES_USB
select RESOURCES_USB_HOST
select USBH_MSTORAGE
select RESOURCES_USB_DEVICE
if BSP_USING_USB
source "$BSP_DIR/third_party_driver/usb/Kconfig"
endif

menuconfig BSP_USING_WDT
bool "Using WATCHDOG device"
default y
select RESOURCES_WDT
if BSP_USING_WDT
source "$BSP_DIR/third_party_driver/watchdog/Kconfig"
endif
```

## board/aiit-arm32-board/third_party_driver/ch438/Kconfig
```kconfig
config CH438_BUS_NAME
    string
    default "extuart"

config CH438_DRIVER_NAME
    string
    default "extuart_drv"

config CH438_DEVICE_NAME_0
    string
    default "extuart_dev0"

config CH438_DEVICE_NAME_1
    string
    default "extuart_dev1"

config CH438_DEVICE_NAME_2
    string
    default "extuart_dev2"

config CH438_DEVICE_NAME_3
    string
    default "extuart_dev3"

config CH438_DEVICE_NAME_4
    string
    default "extuart_dev4"

config CH438_DEVICE_NAME_5
    string
    default "extuart_dev5"

config CH438_DEVICE_NAME_6
    string
    default "extuart_dev6"

config CH438_DEVICE_NAME_7
    string
    default "extuart_dev7"
```

## board/aiit-arm32-board/third_party_driver/extmem/Kconfig
```kconfig
menu "Extern Sram Config"
    config DATA_IN_ExtSRAM
        bool "support extern sram"
        default n
    if  DATA_IN_ExtSRAM
        config EXTSRAM_MAX_NUM
            int
            default 4

        config BSP_USING_FSMC_BANK1_NORSRAM3
            bool "config fsmc bank1 sram3"
            default n
            if BSP_USING_FSMC_BANK1_NORSRAM3
                config BANK1_NORSRAM3_SIZE
                    hex "config sram chip size"
                    default 0x100000
                config BANK1_NORSRAM3_DATA_WIDTH
                    int "sram chip data width"
                    default 16
            endif
    endif
endmenu
```

## board/aiit-arm32-board/third_party_driver/sdio/Kconfig
```kconfig
if BSP_USING_SDIO
config SDIO_BUS_NAME
    string "sdio bus name"
    default "sdio"

config SDIO_DRIVER_NAME
    string "sdio driver name"
    default "sdio_drv"

config SDIO_DEVICE_NAME
    string "sdio device name"
    default "sdio_dev"
endif
```

## board/aiit-arm32-board/third_party_driver/spi/Kconfig
```kconfig
config BSP_USING_SPI1
bool "Using spi1  "
default n

if BSP_USING_SPI1
    config SPI_BUS_NAME_1
        string "spi bus 1 name"
        default "spi1"
    config SPI_1_DRV_NAME
        string "spi bus 1 driver name"
        default "spi1_drv"
endif

config BSP_USING_SPI2
bool "Using spi2  "
default n

if BSP_USING_SPI2
    config SPI_BUS_NAME_2
        string "spi bus 2 name"
        default "spi2"
    config SPI_2_DRV_NAME
        string "spi bus 2 driver name"
        default "spi2_drv"
endif

config BSP_USING_SPI3
bool "Using spi3  "
default n

if BSP_USING_SPI3
    config SPI_BUS_NAME_3
        string "spi bus 3 name"
        default "spi3"
    config SPI_3_DRV_NAME
        string "spi bus 3 driver name"
        default "spi3_drv"
endif
```

## board/aiit-arm32-board/third_party_driver/timer/Kconfig
```kconfig
if BSP_USING_HWTIMER
    config HWTIMER_BUS_NAME_2
    string "hwtimer bus name"
    default "hwtim2"

    menuconfig ENABLE_TIM2
    bool "enable TIM2"
    default y

    if ENABLE_TIM2
        config HWTIMER_2_DEVICE_NAME_2
        string "TIM2 dev name"
        default "hwtim2_dev2"

        config HWTIMER_DRIVER_NAME_2
        string "TIM2 drv name"
        default "hwtim2_drv"
    endif
endif
```

## board/aiit-riscv64-board/Kconfig
```kconfig
mainmenu "XiUOS Project Configuration"

config BSP_DIR
    string
    option env="BSP_ROOT"
    default "."

config KERNEL_DIR
    string
    option env="KERNEL_ROOT"
    default "../.."

config BOARD_AIIT_RISCV_EVB
    bool
    select  ARCH_RISCV
    select ARCH_RISCV64
    select ARCH_CPU_64BIT
    default y

source "$KERNEL_DIR/arch/Kconfig"

menu "aiit-riscv64-board feature"
    source "$BSP_DIR/third_party_driver/Kconfig"

    menu "config default board resources"
        menu "config board app name"
            config BOARD_APP_NAME
                string "config board app name"
                default "/XiUOS_aiit-riscv64-board_app.bin"
        endmenu

        menu "config board service table"
            config SERVICE_TABLE_ADDRESS
                hex "board service table address"
                default 0x80100000
        endmenu

        menu "config hardware resources for connection"
            if CONNECTION_COMMUNICATION_ETHERNET
                config ETHERNET_UART_NAME
                    string "ethernet uart name"
                    default "/dev/uart3_dev3"
            endif
            if CONNECTION_COMMUNICATION_WIFI
                config WIFI_UART_NAME
                    string "wifi uart name"
                    default "/dev/uart3_dev3"
            endif
            if CONNECTION_COMMUNICATION_LORA
                config LORA_SPI_NAME
                    string "lora spi name"
                    default "/dev/spi1_lora"
            endif
        endmenu

    endmenu

    config __STACKSIZE__
        int "stack size for interrupt"
        default 4096

endmenu





menu "Hardware feature"
source "$KERNEL_DIR/resources/Kconfig"
endmenu

source "$KERNEL_DIR/Kconfig"
```

## board/aiit-riscv64-board/third_party_driver/ch376/Kconfig
```kconfig
menuconfig BSP_USING_SDIO
bool "Using CH376 SD card"
default n
select RESOURCES_SDIO
if BSP_USING_SDIO
config SDIO_BUS_NAME
    string "sdio bus name"
    default "sdio"

config SDIO_DRIVER_NAME
    string "sdio driver name"
    default "sdio_drv"

config SDIO_DEVICE_NAME
    string "sdio device name"
    default "sdio_dev"
endif

menuconfig BSP_USING_USB
bool "Using CH376 USB"
default n
select RESOURCES_USB
if BSP_USING_USB
config USB_BUS_NAME
    string "USB bus name"
    default "usb"

config USB_DRIVER_NAME
    string "USB driver name"
    default "usb_drv"

config USB_DEVICE_NAME
    string "USB device name"
    default "usb_dev"
endif
```

## board/aiit-riscv64-board/third_party_driver/ch438/Kconfig
```kconfig
if BSP_USING_CH438
    config CH438_BUS_NAME
        string
        default "extuart"

    config CH438_DRIVER_NAME
        string
        default "extuart_drv"

    config CH438_DEVICE_NAME_0
        string
        default "extuart_dev0"

    config CH438_DEVICE_NAME_1
        string
        default "extuart_dev1"

    config CH438_DEVICE_NAME_2
        string
        default "extuart_dev2"

    config CH438_DEVICE_NAME_3
        string
        default "extuart_dev3"

    config CH438_DEVICE_NAME_4
        string
        default "extuart_dev4"

    config CH438_DEVICE_NAME_5
        string
        default "extuart_dev5"

    config CH438_DEVICE_NAME_6
        string
        default "extuart_dev6"

    config CH438_DEVICE_NAME_7
        string
        default "extuart_dev7"

    config BSP_CH438_ALE_PIN
        int "ALE pin number for ch438"
        default 23

    config BSP_CH438_NWR_PIN
        int "NWR pin number for ch438"
        default 24

    config BSP_CH438_NRD_PIN
        int "NRD pin number for ch438"
        default 25
        
    config BSP_CH438_D0_PIN
        int "D0 pin number for ch438"
        default 27
        
    config BSP_CH438_D1_PIN
        int "D1 pin number for ch438"
        default 28
        
    config BSP_CH438_D2_PIN
        int "D2 pin number for ch438"
        default 29
        
    config BSP_CH438_D3_PIN
        int "D3 pin number for ch438"
        default 30
        
    config BSP_CH438_D4_PIN
        int "D4 pin number for ch438"
        default 31
        
    config BSP_CH438_D5_PIN
        int "D5 pin number for ch438"
        default 32
        
    config BSP_CH438_D6_PIN
        int "D6 pin number for ch438"
        default 33
        
    config BSP_CH438_D7_PIN
        int "D7 pin number for ch438"
        default 34
        
    config BSP_CH438_INT_PIN
        int "INT pin number for ch438"
        default 35
        
    config BSP_485_dir
        int "485 direction pin number for ch438"
        default 18
        

    menuconfig BSP_USING_4G_OR_NB
        bool "Select using the ec200t(4G) or bc28(NB-IOT)"
        default y
        if BSP_USING_4G_OR_NB
            choice
                prompt "Select using the ec200t(4G) or bc28(NB-IOT)"
                default BSP_USING_4G
                config BSP_USING_4G
                    bool "Using ec200t(4G)"
                config BSP_USING_NBIOT
                    bool "Using bc26(NB-IOT)"
            endchoice


            if BSP_USING_4G
                config BSP_4G_STATUS
                    int "STATUS pin number for ec200t"
                    default 21
                config BSP_4G_POWERKEY
                    int "POWERKEY pin number for ec200t"
                    default 37
            endif

            if BSP_USING_NBIOT
                config BSP_NB_RESET
                    int "RESET pin number for bc28"
                    default 21
            endif
        endif

    menuconfig BSP_USING_WIFI_HFA21
        bool "Using the hfa21(WIFI)"
        default y
        if BSP_USING_WIFI_HFA21
            config BSP_WIFI_RST
                int "RESET pin number for hfa21"
                default 22
        endif

endif
```

## board/aiit-riscv64-board/third_party_driver/spi/Kconfig
```kconfig
config BSP_USING_SPI1
bool "Using spi1  "
default y


if BSP_USING_SPI1
    config SPI_BUS_NAME_1
        string "spi bus 1 name"
        default "spi1"
    config SPI_1_DRV_NAME
        string "spi bus 1 driver name"
        default "spi1_drv"    
    config BSP_SPI1_CLK_PIN
        int "spi1 clk pin number"
        default 6
    config BSP_SPI1_D0_PIN
        int "spi1 d0 pin number"
        default 8
    config BSP_SPI1_D1_PIN
        int "spi1 d1 pin number"
        default 7
    menuconfig BSP_SPI1_USING_SS0
        bool "SPI1 Enable SS0"
        default y
    if BSP_SPI1_USING_SS0
        config SPI_1_DEVICE_NAME_0
            string "spi bus 1 device 0 name"
            default "spi1_dev0"        
        config BSP_SPI1_SS0_PIN
            int "spi1 ss0 pin number"
            default 9
    endif
    menuconfig BSP_SPI1_USING_SS1
        bool "SPI1 Enable SS1"
        default y
    if BSP_SPI1_USING_SS1
        config SPI_1_DEVICE_NAME_1
            string "spi bus 1 device 1 name"
            default "spi1_dev1"             
        config BSP_SPI1_SS1_PIN
            int "spi1 ss1 pin number"
            default 33
    endif
    menuconfig BSP_SPI1_USING_SS2
        bool "SPI1 Enable SS2"
        default n
    if BSP_SPI1_USING_SS2
        config SPI_1_DEVICE_NAME_2
            string "spi bus 1 device 2 name"
            default "spi1_dev2"              
        config BSP_SPI1_SS2_PIN
            int "spi1 ss2 pin number"
            default 26
    endif
    menuconfig BSP_SPI1_USING_SS3
        bool "SPI1 Enable SS3"
        default n
    if BSP_SPI1_USING_SS3
        config SPI_1_DEVICE_NAME_3
            string "spi bus 1 device 3 name"
            default "spi1_dev3"               
        config BSP_SPI1_SS3_PIN
            int "spi1 ss3 pin number"
            default 27
    endif
endif

config BSP_USING_TP
bool "Using LCD touch  "
default n

if BSP_USING_TP
    config BSP_TP_SCK_PIN
        int "TP SCK pin number"
        default 42
    config BSP_TP_NCS_PIN
        int "TP NCS pin number"
        default 43
    config BSP_TP_MISO_PIN
        int "TP MISO pin number"
        default 44
    config BSP_TP_IRQ_PIN
        int "TP IRQ pin number"
        default 45
    config BSP_TP_MOSI_PIN
        int "TP MOSI pin number"
        default 46

endif
```

## board/k210-emulator/third_party_driver/Kconfig
```kconfig
menuconfig BSP_USING_DMA
bool "Using DMA device"
default y
if BSP_USING_DMA
source "$BSP_DIR/third_party_driver/dma/Kconfig"
endif

menuconfig BSP_USING_GPIO
bool "Using GPIO device"
default y
select RESOURCES_PIN
if BSP_USING_GPIO
source "$BSP_DIR/third_party_driver/gpio/Kconfig"
endif

menuconfig BSP_USING_PLIC
bool "Using PLIC device"
default y
if BSP_USING_PLIC
source "$BSP_DIR/third_party_driver/plic/Kconfig"
endif

menuconfig BSP_USING_SYSCLOCK
bool "Using SYSCLOCK device"
default y
if BSP_USING_SYSCLOCK
source "$BSP_DIR/third_party_driver/sys_clock/Kconfig"
endif

menuconfig BSP_USING_HWTIMER
bool "Using HWTIMER device"
default n
select RESOURCES_HWTIMER
if BSP_USING_HWTIMER
source "$BSP_DIR/third_party_driver/timer/Kconfig"
endif

menuconfig BSP_USING_UART
bool "Using UART device"
default y
select RESOURCES_SERIAL
if BSP_USING_UART
source "$BSP_DIR/third_party_driver/uart/Kconfig"
endif
```

## board/kd233/third_party_driver/rtc/Kconfig
```kconfig
if BSP_USING_RTC
    config RTC_BUS_NAME
        string "rtc bus name"
        default "rtc"
    config RTC_DRV_NAME
        string "rtc bus driver name"
        default "rtc_drv"
    config RTC_DEVICE_NAME
            string "rtc bus device name"
            default "rtc_dev"     
endif
```
