## Ubiquitous/XiUOS/arch/Kconfig
```kconfig
config ARCH_CPU_64BIT
    bool

config ARCH_RISCV
    bool

config ARCH_ARM
    bool

config ARCH_RISCV64
    select ARCH_RISCV
    select ARCH_CPU_64BIT
    bool
```

## Ubiquitous/XiUOS/board/aiit-arm32-board/third_party_driver/spi/Kconfig
```kconfig
config BSP_USING_SPI1
bool "Using spi1  "
default n

if BSP_USING_SPI1
    config SPI_BUS_NAME_1
        string "spi bus 1 name"
        default "spi1"
    config SPI_1_DRV_NAME
        string "spi bus 1 driver name"
        default "spi1_drv"
endif

config BSP_USING_SPI2
bool "Using spi2  "
default n

if BSP_USING_SPI2
    config SPI_BUS_NAME_2
        string "spi bus 2 name"
        default "spi2"
    config SPI_2_DRV_NAME
        string "spi bus 2 driver name"
        default "spi2_drv"
    menuconfig CONNECTION_COMMUNICATION_LORA_USING_SX1278
    bool "Using spi lora SX1278"
    default n
    if CONNECTION_COMMUNICATION_LORA_USING_SX1278
    config SX12XX_SPI_DEVICE_NAME
        string "SX1278 device spi name"
        default "spi2_dev0"
    config SX12XX_DEVICE_NAME
        string "SX1278 device name"
        default "spi2_lora"

    config CONNECTION_COMMUNICATION_LORA_SX12XX_RST_PIN
        int
        default 10

    config CONNECTION_COMMUNICATION_LORA_SX12XX_DO0_PIN
        int
        default 10

    config CONNECTION_COMMUNICATION_LORA_SX12XX_DO1_PIN
        int
        default 10

    config CONNECTION_COMMUNICATION_LORA_SX12XX_DO2_PIN
        int
        default 10
    
    config CONNECTION_COMMUNICATION_LORA_SX12XX_DO3_PIN
        int
        default 10
    
    config CONNECTION_COMMUNICATION_LORA_SX12XX_DO4_PIN
        int
        default 10
    
    config CONNECTION_COMMUNICATION_LORA_SX12XX_DO5_PIN
        int
        default 10
    endif
endif

config BSP_USING_SPI3
bool "Using spi3  "
default n

if BSP_USING_SPI3
    config SPI_BUS_NAME_3
        string "spi bus 3 name"
        default "spi3"
    config SPI_3_DRV_NAME
        string "spi bus 3 driver name"
        default "spi3_drv"
endif
```

## Ubiquitous/XiUOS/board/aiit-riscv64-board/third_party_driver/Kconfig
```kconfig
menuconfig BSP_USING_CH376
bool "Using CH376 device"
default n
select FS_VFS
select FS_CH376
if BSP_USING_CH376
source "$BSP_DIR/third_party_driver/ch376/Kconfig"
endif

menuconfig BSP_USING_CH438
bool "Using CH438 device"
default y
if BSP_USING_CH438
source "$BSP_DIR/third_party_driver/ch438/Kconfig"
endif

menuconfig BSP_USING_DMA
bool "Using DMA device"
default y
if BSP_USING_DMA
source "$BSP_DIR/third_party_driver/dma/Kconfig"
endif

menuconfig BSP_USING_GPIO
bool "Using GPIO device"
default y
select RESOURCES_PIN
if BSP_USING_GPIO
source "$BSP_DIR/third_party_driver/gpio/Kconfig"
endif

menuconfig BSP_USING_I2C
bool "Using I2C device"
default n
select RESOURCES_I2C
if BSP_USING_I2C
source "$BSP_DIR/third_party_driver/i2c/Kconfig"
endif

menuconfig BSP_USING_LCD
bool "Using LCD device"
default n
select RESOURCES_LCD
select BSP_USING_SPI1
if BSP_USING_LCD
source "$BSP_DIR/third_party_driver/lcd/Kconfig"
endif

menuconfig BSP_USING_PLIC
bool "Using PLIC device"
default y
if BSP_USING_PLIC
source "$BSP_DIR/third_party_driver/plic/Kconfig"
endif

menuconfig BSP_USING_RTC
bool "Using RTC device"
default n
select RESOURCES_RTC
if BSP_USING_RTC
source "$BSP_DIR/third_party_driver/rtc/Kconfig"
endif

menuconfig BSP_USING_SPI
bool "Using SPI device"
default n
select RESOURCES_SPI
select  BSP_USING_DMA
if BSP_USING_SPI
source "$BSP_DIR/third_party_driver/spi/Kconfig"
endif

menuconfig BSP_USING_SYSCLOCK
bool "Using SYSCLOCK device"
default y
if BSP_USING_SYSCLOCK
source "$BSP_DIR/third_party_driver/sys_clock/Kconfig"
endif

menuconfig BSP_USING_HWTIMER
bool "Using HWTIMER device"
default n
select RESOURCES_HWTIMER
if BSP_USING_HWTIMER
source "$BSP_DIR/third_party_driver/timer/Kconfig"
endif

menuconfig BSP_USING_TOUCH
bool "Using TOUCH device"
default n
select RESOURCES_TOUCH
if BSP_USING_TOUCH
source "$BSP_DIR/third_party_driver/touch/Kconfig"
endif

menuconfig BSP_USING_UART
bool "Using UART device"
default y
select RESOURCES_SERIAL
if BSP_USING_UART
source "$BSP_DIR/third_party_driver/uart/Kconfig"
endif

menuconfig BSP_USING_WDT
bool "Using WATCHDOG device"
default y
select RESOURCES_WDT
if BSP_USING_WDT
source "$BSP_DIR/third_party_driver/watchdog/Kconfig"
endif
```

## Ubiquitous/XiUOS/board/aiit-riscv64-board/third_party_driver/lcd/Kconfig
```kconfig
if BSP_USING_LCD
    config LCD_BUS_NAME_1
        string "lcd bus 1 name"
        default "lcd1"
    config LCD_DRV_NAME_1
        string "lcd bus 1 driver name"
        default "lcd1drv"
    config LCD_1_DEVICE_NAME_0
            string "lcd bus 1 device 0 name"
            default "lcd10"   
    config BSP_LCD_CS_PIN
        int "CS pin number of 8080 interface"
        default 40
    config BSP_LCD_WR_PIN
        int "WR pin number of 8080 interface"
        default 38
    config BSP_LCD_DC_PIN
        int "DC pin number of 8080 interface"
        default 41
    config FPIOA_LCD_DC
        int "DC FPIOA number of 8080 interface"
        default 2
    config BSP_LCD_BL_PIN
        int "BL pin number of 8080 interface"
        default 47
    config FPIOA_LCD_BL
        int "BL FPIOA number of 8080 interface"
        default 10
    config BSP_LCD_X_MAX
        int "LCD Height"
        default 240
    config BSP_LCD_Y_MAX
        int "LCD Width"
        default 320
endif
```

## Ubiquitous/XiUOS/board/aiit-riscv64-board/third_party_driver/touch/Kconfig
```kconfig
config TOUCH_BUS_NAME_1
    string "touch bus 1 name"
    default "touch1"
config TOUCH_DRV_NAME_1
    string "touch bus 1 driver name"
    default "touch1drv"
config TOUCH_1_DEVICE_NAME_0
    string "touch bus 1 device 0 name"
    default "touch10"   
```

## Ubiquitous/XiUOS/board/k210-emulator/third_party_driver/uart/Kconfig
```kconfig
menuconfig BSP_USING_UART_HS
    bool "Enable High Speed UART"
    default y
    if BSP_USING_UART_HS
        config SERIAL_BUS_NAME_0
            string "serial high speed bus 0 name"
            default "uart0"
        config SERIAL_DRV_NAME_0
            string "serial high speed bus 0 driver name"
            default "uart0_drv"
        config SERIAL_0_DEVICE_NAME_0
            string "serial high speed bus 0 device 0 name"
            default "uart0_dev0"   
    endif

menuconfig BSP_USING_UART1
    bool "Enable UART1"
    default y
    if BSP_USING_UART1
        config BSP_UART1_TXD_PIN
            int "uart1 TXD pin number"
            default 20
        config BSP_UART1_RXD_PIN
            int "uart1 RXD pin number"
            default 21
        config SERIAL_BUS_NAME_1
            string "serial bus 1 name"
            default "uart1"
        config SERIAL_DRV_NAME_1
            string "serial bus 1 driver name"
            default "uart1_drv"
        config SERIAL_1_DEVICE_NAME_0
                string "serial bus 1 device 0 name"
                default "uart1_dev1"   
    endif

menuconfig BSP_USING_UART2
    bool "Enable UART2"
    default y
    if BSP_USING_UART2
        config BSP_UART2_TXD_PIN
            int "uart2 TXD pin number"
            default 28
        config BSP_UART2_RXD_PIN
            int "uart2 RXD pin number"
            default 27
        config SERIAL_BUS_NAME_2
            string "serial bus 2 name"
            default "uart2"
        config SERIAL_DRV_NAME_2
            string "serial bus 2 driver name"
            default "uart2_drv"
        config SERIAL_2_DEVICE_NAME_0
                string "serial bus 2 device 0 name"
                default "uart2_dev2"   
    endif

menuconfig BSP_USING_UART3
    bool "Enable UART3"
    default y
    if BSP_USING_UART3
        config BSP_UART3_TXD_PIN
            int "uart3 TXD pin number"
            default 22
        config BSP_UART3_RXD_PIN
            int "uart3 RXD pin number"
            default 23
        config SERIAL_BUS_NAME_3
            string "serial bus 3 name"
            default "uart3"
        config SERIAL_DRV_NAME_3
            string "serial bus 3 driver name"
            default "uart3_drv"
        config SERIAL_3_DEVICE_NAME_0
                string "serial bus 3 device 0 name"
                default "uart3_dev3"   
    endif
```

## Ubiquitous/XiUOS/board/k210-emulator/third_party_driver/watchdog/Kconfig
```kconfig
menuconfig BSP_USING_WDT0
bool "Using watchdog 0 "
default n
if BSP_USING_WDT0
config WDT_BUS_NAME_0
    string "watchdog bus 0 name"
    default "wdt0"

config WDT_DRIVER_NAME_0
    string "watchdog driver 0 name"
    default "wdt0_drv"

config WDT_0_DEVICE_NAME_0
    string "watchdog device 0 name"
    default "wdt0_dev0"
endif

menuconfig BSP_USING_WDT1
bool "Using watchdog 1 "
default n
if BSP_USING_WDT1
config WDT_BUS_NAME_1
    string "watchdog bus 1 name"
    default "wdt1"

config WDT_DRIVER_NAME_1
    string "watchdog driver 1 name"
    default "wdt1_drv"

config WDT_1_DEVICE_NAME_1
    string "watchdog device 1 name"
    default "wdt1_dev1"
endif
```

## Ubiquitous/XiUOS/board/kd233/Kconfig
```kconfig
mainmenu "XiUOS Project Configuration"

config BSP_DIR
    string
    option env="BSP_ROOT"
    default "."

config KERNEL_DIR
    string
    option env="KERNEL_ROOT"
    default "../.."

config BOARD_K210_EVB
    bool
    select  ARCH_RISCV
    select ARCH_RISCV64
    select ARCH_CPU_64BIT
    default y

config LED0
    int
    default 24

 config LED1
    int
    default 25   


source "$KERNEL_DIR/arch/Kconfig"

menu "kd233 feature"
    source "$BSP_DIR/third_party_driver/Kconfig"

    menu "config default board resources"
        menu "config board app name"
            config BOARD_APP_NAME
                string "config board app name"
                default "/XiUOS_kd233_app.bin"
        endmenu

        menu "config board service table"
            config SERVICE_TABLE_ADDRESS
                hex "board service table address"
                default 0x80100000
        endmenu

        menu "config hardware resources for connection"
            if CONNECTION_COMMUNICATION_ETHERNET
                config ETHERNET_UART_NAME
                    string "ethernet uart name"
                    default "/dev/uart3_dev3"
            endif
            if CONNECTION_COMMUNICATION_WIFI
                config WIFI_UART_NAME
                    string "wifi uart name"
                    default "/dev/uart3_dev3"
            endif

        endmenu

    endmenu

    config __STACKSIZE__
        int "stack size for interrupt"
        default 4096

endmenu





menu "Hardware feature"
source "$KERNEL_DIR/resources/Kconfig"
endmenu

source "$KERNEL_DIR/Kconfig"
```

## Ubiquitous/XiUOS/board/kd233/third_party_driver/timer/Kconfig
```kconfig
if BSP_USING_HWTIMER
    config HWTIMER_BUS_NAME_1
    string "hwtimer bus name"
    default "hwtim1"

    menuconfig ENABLE_TIM1
    bool "enable TIM1"
    default y

    if ENABLE_TIM1
        config HWTIMER_1_DEVICE_NAME_1
        string "TIM1 dev name"
        default "hwtim1_dev1"

        config HWTIMER_DRIVER_NAME_1
        string "TIM1 drv name"
        default "hwtim1_drv"
    endif
endif
```

## Ubiquitous/XiUOS/board/maix-go/Kconfig
```kconfig
mainmenu "XiUOS Project Configuration"

config BSP_DIR
    string
    option env="BSP_ROOT"
    default "."

config KERNEL_DIR
    string
    option env="KERNEL_ROOT"
    default "../.."

config BOARD_MAIX_GO_EVB
    bool
    select  ARCH_RISCV
    select ARCH_RISCV64
    select ARCH_CPU_64BIT
    default y

source "$KERNEL_DIR/arch/Kconfig"


menu "spieed maix go feature"
    source "$BSP_DIR/third_party_driver/Kconfig"

     menu "config default board resources"
        menu "config board app name"
            config BOARD_APP_NAME
                string "config board app name"
                default "/XiUOS_maix-go_app.bin"
        endmenu

        menu "config board service table"
            config SERVICE_TABLE_ADDRESS
                hex "board service table address"
                default 0x80100000
        endmenu

    endmenu

    config __STACKSIZE__
        int "stack size for interrupt"
        default 4096

endmenu





menu "Hardware feature"
    source "$KERNEL_DIR/resources/Kconfig"
endmenu

source "$KERNEL_DIR/Kconfig"
```

## Ubiquitous/XiUOS/board/maix-go/third_party_driver/Kconfig
```kconfig
menuconfig BSP_USING_PLIC
bool "Using PLIC device"
default y
if BSP_USING_PLIC
source "$BSP_DIR/third_party_driver/plic/Kconfig"
endif



menuconfig BSP_USING_SYSCLOCK
bool "Using SYSCLOCK device"
default y
if BSP_USING_SYSCLOCK
source "$BSP_DIR/third_party_driver/sys_clock/Kconfig"
endif



menuconfig BSP_USING_UART
bool "Using UART device"
default y
select RESOURCES_SERIAL
if BSP_USING_UART
source "$BSP_DIR/third_party_driver/uart/Kconfig"
endif
```

## Ubiquitous/XiUOS/board/ok1052-c/third_party_driver/Kconfig
```kconfig
menuconfig BSP_USING_LPUART
bool "Using UART device"
default y
select RESOURCES_SERIAL
if BSP_USING_LPUART
source "$BSP_DIR/third_party_driver/uart/Kconfig"
endif
```

## Ubiquitous/XiUOS/board/ok1052-c/third_party_driver/uart/Kconfig
```kconfig
config BSP_USING_LPUART1
bool "Enable LPUART1"
default y
if BSP_USING_LPUART1
    config SERIAL_BUS_NAME_1
        string "serial bus 1 name"
        default "uart1"
    config SERIAL_DRV_NAME_1
        string "serial bus 1 driver name"
        default "uart1_drv"
    config SERIAL_1_DEVICE_NAME_0
            string "serial bus 1 device name"
            default "uart1_dev1"   
endif

config BSP_USING_LPUART2
bool "Enable LPUART2"
default y
if BSP_USING_LPUART2
    config SERIAL_BUS_NAME_2
        string "serial bus 2 name"
        default "uart2"
    config SERIAL_DRV_NAME_2
        string "serial bus 2 driver name"
        default "uart2_drv"
    config SERIAL_2_DEVICE_NAME_0
            string "serial bus 2 device name"
            default "uart2_dev2"   
endif
```

## Ubiquitous/XiUOS/board/stm32f407-st-discovery/third_party_driver/ethernet/Kconfig
```kconfig
config CAN_BUS_NAME_1
    string "can bus name"
    default "can1"

config CAN_DRIVER_NAME
    string "can driver name"
    default "can1_drv"

config CAN_1_DEVICE_NAME_1
    string "can bus 1 device 1 name"
    default "can1_dev1"
```

## Ubiquitous/XiUOS/board/stm32f407-st-discovery/third_party_driver/usb/Kconfig
```kconfig
config BSP_USING_USBH
    bool "Using usb host"
    default y
        config USB_BUS_NAME
            string "usb bus name"
            default "usb"
        config USB_DRIVER_NAME
            string "usb bus driver name"
            default "usb_drv"
        config USB_DEVICE_NAME
            string "usb bus device name"
            default "usb_dev"
```

## Ubiquitous/XiUOS/board/stm32f407-st-discovery/third_party_driver/watchdog/Kconfig
```kconfig
if BSP_USING_WDT
config WDT_BUS_NAME
    string "watchdog bus name"
    default "wdt"

config WDT_DRIVER_NAME
    string "watchdog driver name"
    default "wdt_drv"

config WDT_DEVICE_NAME
    string "watchdog device name"
    default "wdt_dev"
endif
```
