## Ubiquitous/XiUOS/board/stm32f407zgt6/Kconfig
```kconfig
mainmenu "XiUOS Project Configuration"

config BSP_DIR
    string
    option env="BSP_ROOT"
    default "."

config KERNEL_DIR
    string
    option env="KERNEL_ROOT"
    default "../.."

config BOARD_STM32F407_EVB
    bool
    select  ARCH_ARM
    default y

source "$KERNEL_DIR/arch/Kconfig"

menu "stm32f407zgt6 feature"
    source "$BSP_DIR/third_party_driver/Kconfig"
    menu "config default board resources"
        menu "config board app name"
            config BOARD_APP_NAME
                string "config board app name"
                default "/XiUOS_stm32f407zgt6_app.bin"
        endmenu

        menu "config board service table"
            config SERVICE_TABLE_ADDRESS
                hex "board service table address"
                default 0x20000000
        endmenu

        menu "config hardware resources for connection"
            if CONNECTION_COMMUNICATION_ETHERNET
                config ETHERNET_UART_NAME
                    string "ethernet uart name"
                    default "/dev/usart3_dev3"
            endif
            if CONNECTION_COMMUNICATION_WIFI
                config WIFI_UART_NAME
                    string "wifi uart name"
                    default "/dev/usart3_dev3"
            endif

        endmenu

    endmenu
endmenu


menu "Hardware feature"
source "$KERNEL_DIR/resources/Kconfig"
endmenu

source "$KERNEL_DIR/Kconfig"
```

## Ubiquitous/XiUOS/board/stm32f407zgt6/third_party_driver/Kconfig
```kconfig
menuconfig BSP_USING_GPIO
bool "Using GPIO device "
default y
select RESOURCES_PIN
if BSP_USING_GPIO
source "$BSP_DIR/third_party_driver/gpio/Kconfig"
endif

menuconfig BSP_USING_UART
bool "Using UART device"
default y
select RESOURCES_SERIAL
if BSP_USING_UART
source "$BSP_DIR/third_party_driver/uart/Kconfig"
endif

menuconfig BSP_USING_EXTMEM
bool "Using extern memory"
default n
select MEM_EXTERN_SRAM
if BSP_USING_EXTMEM
source "$BSP_DIR/third_party_driver/extmem/Kconfig"
endif
```

## Ubiquitous/XiUOS/board/stm32f407zgt6/third_party_driver/extmem/Kconfig
```kconfig
if  BSP_USING_EXTMEM
    config EXTSRAM_MAX_NUM
        int
        default 4
        
    config BSP_USING_FSMC_BANK1_NORSRAM3
        bool "config fsmc bank1 sram3"
        default n
        if BSP_USING_FSMC_BANK1_NORSRAM3
            config BANK1_NORSRAM3_SIZE
                hex "config sram3 chip size"
                default 0x100000
            config BANK1_NORSRAM3_DATA_WIDTH
                int "config sram3 chip data width"
                default 16 
        endif
endif
```

## Ubiquitous/XiUOS/framework/Kconfig
```kconfig
menu "APP Framework"

source "$KERNEL_DIR/framework/connection/Kconfig"

source "$KERNEL_DIR/framework/intelligent/Kconfig"

source "$KERNEL_DIR/framework/control/Kconfig"

source "$KERNEL_DIR/lib/Kconfig"

source "$KERNEL_DIR/framework/security/Kconfig"



endmenu
```

## Ubiquitous/XiUOS/framework/connection/Adapter/lora/Kconfig
```kconfig
#LORA adhoc configuration
#Set same netID, and then join one adhoc net.

menuconfig CONNECTION_COMMUNICATION_BOOTSTART_LORA_NET_SAMPLE
    bool "use bootstart lora net sample"
    default n

    if CONNECTION_COMMUNICATION_BOOTSTART_LORA_NET_SAMPLE
    menuconfig CONNECTION_COMMUNICATION_SET_AS_LORA_CLIENT
        bool "set this as lora client "
        default n

        if CONNECTION_COMMUNICATION_SET_AS_LORA_CLIENT
        config CONNECTION_COMMUNICATION_LORA_CLIENT_NAME 
        string "config lora net client name"
        default "lora_client_name0"

        config CONNECTION_COMMUNICATION_LORA_CLIENT_PKG_COUNT
        int "config lora send pkg count"
        default 1000
        endif

    menuconfig CONNECTION_COMMUNICATION_SET_AS_LORA_GATEWAY
        bool "set this as lora gateway"
        default n

    config CONNECTION_COMMUNICATION_LORA_NET_ID
    string "config lora net ID"
    default "intelligence grain"
    endif
```

## Ubiquitous/XiUOS/framework/connection/Adapter/zigbee/Kconfig
```kconfig
menuconfig CONNECTION_COMMUNICATION_ZIGBEE_AIIT
bool "Enable zigbee for AIIT Board"
default n

menuconfig CONNECTION_COMMUNICATION_ZIGBEE_KD233
bool "Enable zigbee for kd233"
default n

menuconfig CONNECTION_COMMUNICATION_ZIGBEE_STM32
bool "Enable zigbee for STM32F407-DISCOVERY"
default n
```

## Ubiquitous/XiUOS/framework/connection/Kconfig
```kconfig
menu "connection"

menuconfig CONNECTION_ADAPTER
bool "Enable adapter"
default n
if CONNECTION_ADAPTER
source "$KERNEL_DIR/framework/connection/Adapter/Kconfig"
endif


endmenu
```
