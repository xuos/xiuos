## board/stm32f407-st-discovery/third_party_driver/i2c/Kconfig
```kconfig
if BSP_USING_I2C
    config I2C_BUS_NAME_1
        string "i2c bus 1 name"
        default "i2c1"
    config I2C_DRV_NAME_1
        string "i2c bus 1 driver name"
        default "i2c1_drv"
    config I2C_1_DEVICE_NAME_0
            string "i2c bus 1 device 0 name"
            default "i2c1_dev0"     
endif
```

## board/stm32f407-st-discovery/third_party_driver/spi/Kconfig
```kconfig
config BSP_USING_SPI1
bool "Using spi1  "
default y


if BSP_USING_SPI1
    config SPI_BUS_NAME_1
        string "spi bus 1 name"
        default "spi1"
    config SPI_1_DRV_NAME
        string "spi bus 1 driver name"
        default "spi1_drv"        
    config BSP_SPI1_CLK_PIN
        int "spi1 clk pin number"
        default 29
    config BSP_SPI1_D0_PIN
        int "spi1 d0 pin number"
        default 30
    config BSP_SPI1_D1_PIN
        int "spi1 d1 pin number"
        default 31
    menuconfig BSP_SPI1_USING_SS0
        bool "SPI1 Enable SS0"
        default y
    if BSP_SPI1_USING_SS0
        config SPI_1_DEVICE_NAME_0
            string "spi bus 1 device 0 name"
            default "spi1_dev0"             
        config BSP_SPI1_SS0_PIN
            int "spi1 ss0 pin number"
            default 32
    endif
    menuconfig BSP_SPI1_USING_SS1
        bool "SPI1 Enable SS1"
        default y
    if BSP_SPI1_USING_SS1
        config SPI_1_DEVICE_NAME_1
            string "spi bus 1 device 1 name"
            default "spi1_dev1"           
        config BSP_SPI1_SS1_PIN
            int "spi1 ss1 pin number"
            default 33
    endif
    menuconfig BSP_SPI1_USING_SS2
        bool "SPI1 Enable SS2"
        default n
    if BSP_SPI1_USING_SS2
        config SPI_1_DEVICE_NAME_2
            string "spi bus 1 device 2 name"
            default "spi1_dev2"              
        config BSP_SPI1_SS2_PIN
            int "spi1 ss2 pin number"
            default 26
    endif
    menuconfig BSP_SPI1_USING_SS3
        bool "SPI1 Enable SS3"
        default n
    if BSP_SPI1_USING_SS3
        config SPI_1_DEVICE_NAME_3
            string "spi bus 1 device 3 name"
            default "spi1_dev3"             
        config BSP_SPI1_SS3_PIN
            int "spi1 ss3 pin number"
            default 27
    endif
endif
```

## board/stm32f407-st-discovery/third_party_driver/uart/Kconfig
```kconfig
menuconfig BSP_USING_USART1
    bool "Enable USART1"
    default y
    if BSP_USING_USART1
        config SERIAL_BUS_NAME_1
            string "serial bus 1 name"
            default "usart1"
        config SERIAL_DRV_NAME_1
            string "serial bus 1 driver name"
            default "usart1_drv"
        config SERIAL_1_DEVICE_NAME_0
                string "serial bus 1 device 0 name"
                default "usart1_dev1"   
    endif

menuconfig BSP_USING_USART2
    bool "Enable USART2"
    default y
    if BSP_USING_USART2
        config SERIAL_BUS_NAME_2
            string "serial bus 2 name"
            default "usart2"
        config SERIAL_DRV_NAME_2
            string "serial bus 2 driver name"
            default "usart2_drv"
        config SERIAL_2_DEVICE_NAME_0
                string "serial bus 2 device 0 name"
                default "usart2_dev2"   
    endif

menuconfig BSP_USING_USART3
    bool "Enable USART3"
    default y
    if BSP_USING_USART3
        config SERIAL_BUS_NAME_3
            string "serial bus 3 name"
            default "usart3"
        config SERIAL_DRV_NAME_3
            string "serial bus 3 driver name"
            default "usart3_drv"
        config SERIAL_3_DEVICE_NAME_0
                string "serial bus 3 device 0 name"
                default "usart3_dev3"   
    endif

menuconfig BSP_USING_UART4
    bool "Enable UART4"
    default n
    if BSP_USING_UART4
        config SERIAL_BUS_NAME_4
            string "serial bus 4 name"
            default "uart4"
        config SERIAL_DRV_NAME_4
            string "serial bus 4 driver name"
            default "uart4drv"
        config SERIAL_4_DEVICE_NAME_0
                string "serial bus 4 device 0 name"
                default "uart4_dev4"   
    endif

menuconfig BSP_USING_UART5
    bool "Enable UART5"
    default n
    if BSP_USING_UART5
        config SERIAL_BUS_NAME_5
            string "serial bus 5 name"
            default "uart5"
        config SERIAL_DRV_NAME_5
            string "serial bus 5 driver name"
            default "uart5_drv"
        config SERIAL_5_DEVICE_NAME_0
                string "serial bus 5 device 0 name"
                default "uart5_dev5"   
    endif
```

## board/stm32f407zgt6/third_party_driver/extmem/Kconfig
```kconfig
if  BSP_USING_EXTMEM
    config EXTSRAM_MAX_NUM
        int
        default 4

    config BSP_USING_FSMC_BANK1_NORSRAM1
        bool "config fsmc bank1 sram1"
        default n
        if BSP_USING_FSMC_BANK1_NORSRAM1
            config BANK1_NORSRAM1_SIZE
                hex "config sram1 chip size"
                default 0x100000
            config BANK1_NORSRAM1_DATA_WIDTH
                int "config sram1 chip data width"
                default 16 
        endif

    config BSP_USING_FSMC_BANK1_NORSRAM2
        bool "config fsmc bank1 sram2"
        default n
        if BSP_USING_FSMC_BANK1_NORSRAM2
            config BANK1_NORSRAM2_SIZE
                hex "config sram2 chip size"
                default 0x100000
            config BANK1_NORSRAM2_DATA_WIDTH
                int "config sram2 chip data width"
                default 16 
        endif
        
    config BSP_USING_FSMC_BANK1_NORSRAM3
        bool "config fsmc bank1 sram3"
        default n
        if BSP_USING_FSMC_BANK1_NORSRAM3
            config BANK1_NORSRAM3_SIZE
                hex "config sram3 chip size"
                default 0x100000
            config BANK1_NORSRAM3_DATA_WIDTH
                int "config sram3 chip data width"
                default 16 
        endif

    config BSP_USING_FSMC_BANK1_NORSRAM4
        bool "config fsmc bank1 sram4"
        default n
        if BSP_USING_FSMC_BANK1_NORSRAM4
            config BANK1_NORSRAM4_SIZE
                hex "config sram4 chip size"
                default 0x100000
            config BANK1_NORSRAM4_DATA_WIDTH
                int "config sram4 chip data width"
                default 16 
        endif
endif
```

## framework/connection/Adapter/Kconfig
```kconfig
menuconfig CONNECTION_COMMUNICATION_WIFI
    bool "Enable Wifi"
    default n
    
menuconfig CONNECTION_COMMUNICATION_LORA
bool "Enable LORA"
default n
if CONNECTION_COMMUNICATION_LORA
source "$KERNEL_DIR/framework/connection/Adapter/lora/Kconfig"
endif

menuconfig CONNECTION_COMMUNICATION_ETHERNET
    bool "Enable Ethernet"
    default n

menuconfig CONNECTION_COMMUNICATION_ZIGBEE
    bool "Enable Zigbee"
    default n


menuconfig CONNECTION_COMMUNICATION_NB_IOT
    bool "Enable NB-IOT"
    default n

menuconfig CONNECTION_COMMUNICATION_4G
    bool "Enable 4G"
    default n
```

## framework/connection/Adapter/zigbee/Kconfig
```kconfig
menuconfig CONNECTION_COMMUNICATION_ZIGBEE_AIIT
bool "Enable zigbee for AIIT Board"
default n

menuconfig CONNECTION_COMMUNICATION_ZIGBEE_KD233
bool "Enable zigbee for kd233"
default n
```

## framework/intelligent/tflite-mcu/Kconfig
```kconfig
config INTELLIGENT_TFLITE
    bool "Tensorflow Lite for Micro"
    select  LIB_CPLUSPLUS
    default n
```

## framework/perception/Kconfig
```kconfig
menu "Perception"

menuconfig PERCEPTION_SENSORDEVICE
        bool "Using sensor devices"
        default n

if PERCEPTION_SENSORDEVICE
        menuconfig PERCEPTION_CO2
                bool "Using CO2 sensor device"
                default n
        if PERCEPTION_CO2
        source "$KERNEL_DIR/framework/perception/co2/Kconfig"
        endif

        menuconfig PERCEPTION_PM
                bool "Using PM sensor device"
                default n
        if PERCEPTION_PM
        source "$KERNEL_DIR/framework/perception/pm/Kconfig"
        endif

        menuconfig PERCEPTION_VOICE
                bool "Using voice sensor device"
                default n
        if PERCEPTION_VOICE
        source "$KERNEL_DIR/framework/perception/voice/Kconfig"
        endif

        menuconfig PERCEPTION_TEMPERATURE
                bool "Using temperature sensor device"
                default n
        if PERCEPTION_TEMPERATURE
        source "$KERNEL_DIR/framework/perception/temperature/Kconfig"
        endif

        menuconfig PERCEPTION_HUMIDITY
                bool "Using humidity sensor device"
                default n
        if PERCEPTION_HUMIDITY
        source "$KERNEL_DIR/framework/perception/humidity/Kconfig"
        endif
endif

endmenu
```

## framework/perception/voice/Kconfig
```kconfig
config PERCEPTION_D124
        bool "Using D124"
        default n

        if PERCEPTION_D124
                config SENSOR_DEVICE_D124
                        string "D124 sensor name"
                        default "d124_1"
                
                config SENSOR_QUANTITY_D124_VOICE
                        string "D124 quantity PM1.0 name"
                        default "voice_1"
                
                config SENSOR_DEVICE_D124_DEV
                        string "D124 device name"
                        default "/dev/extuart_dev4"

                config SENSOR_DEVICE_D124_DEV_EXT_PORT
                        int "if D124 device using extuart, choose port"
                        default "4"
        endif
```

## fs/Kconfig
```kconfig
menu "File system"

menuconfig FS_VFS
    bool "Using device virtual file system"
    select KERNEL_MUTEX
    default y
    help
        The device file system is a light weight virtual file system.

if FS_VFS
    source "$KERNEL_DIR/fs/iot-devicefile/Kconfig"

    config FS_VFS_FATFS
    bool "Using FATFS file system"
    default y
    if FS_VFS_FATFS
        source "$KERNEL_DIR/fs/fatfs/Kconfig"
    endif

    config FS_CH376
    bool "Using CH376 file system"
    default n
    if FS_CH376
        source "$KERNEL_DIR/fs/compatibility_ch376/Kconfig"
    endif

    config FS_LWEXT4
    bool "Using LWEXT4 file system"
    default n
    if FS_LWEXT4
        source "$KERNEL_DIR/fs/lwext4/Kconfig"
    endif

endif

endmenu
```

## kernel/kernel_test/Kconfig
```kconfig
menuconfig KERNEL_TEST
    bool "Enable kernel test function "
    default n

    if KERNEL_TEST
        config KERNEL_TEST_AVLTREE
            bool "Config test avl tree"
            default n
            select KERNEL_AVL_TREE
        config KERNEL_TEST_CRICULAR_AREA
            bool "Config test Circular area"
            default n
            select KERNEL_CIRCULAR_AREA
        config KERNEL_TEST_MEM
            bool "Config test mem"
            default n
            select KERNEL_MEMBLOCK
        config KERNEL_TEST_TIMER
            bool "Config test timer"
            default n
        config KERNEL_TEST_IWG
            bool "Config test iwg"
            default n
            select BSP_USING_WDT
        config KERNEL_TEST_REALTIME
            bool "Config test realtime"
            default n
        config KERNEL_TEST_DBG
            bool "Config test dbg"
            default n
            select KERNEL_DEBUG
        config KERNEL_TEST_SCHED
            bool "Config test sched"
            default n
        config KERNEL_TEST_RTC
            bool "Config test rtc"
            default n
        config KERNEL_TEST_SERIAL
            bool "Config test serial"
            default n
        config KERNEL_TEST_HWTIMER
            bool "Config test hwtimer"
            default n
        config KERNEL_TEST_CAN
            bool "Config test can"
            default n
        config KERNEL_TEST_TOUCH
            bool "Config test touch"
            default n
        config KERNEL_TEST_LCD
            bool "Config test lcd"
            default n
        config KERNEL_TEST_CH438
            bool "Config test ch438"
            default n
        config KERNEL_TEST_I2C
            bool "Config test i2c"
            default n
        config KERNEL_TEST_RISC_CAN
            bool "Config test riscv can "
            default n
    endif
```

## tool/shell/Kconfig
```kconfig
menu "Command shell"

menuconfig TOOL_SHELL
    bool "Enable letter-shell function"
    default y

if TOOL_SHELL
    config SHELL_ENTER_CR
    bool
    config SHELL_ENTER_LF
    bool
    
    choice
    prompt "Set shell end-of-line markers :"
        default SHELL_ENTER_CR_AND_LF
    
    config SHELL_ENTER_CR_AND_LF
        bool "Using CR And LF as end-of-line markers"
        select SHELL_ENTER_CR
        select SHELL_ENTER_LF    
    
    config SHELL_ENTER_CRLF
        bool "Using CRLF as end-of-line markers"
    endchoice

    menu "Set shell user control"
        config SHELL_DEFAULT_USER
            string "Set default user's name"
            default "letter"
        
        config SHELL_DEFAULT_USER_PASSWORD
            string "Set default user's password(none for unnecessary)"
            default ""

        config SHELL_LOCK_TIMEOUT
            int "Set the lock time(ms) if password isn't none."
            default 10000
    endmenu

    menu "Set shell config param"
        config SHELL_TASK_STACK_SIZE
            int "Set the stack size for shell "
            default 4096
        
        config SHELL_TASK_PRIORITY
            int
            default 5  if KTASK_PRIORITY_8
            default 20  if KTASK_PRIORITY_32
            default 120  if KTASK_PRIORITY_256
        
        config SHELL_MAX_NUMBER
        int "Set the max shell count"
        default 5

        config SHELL_PARAMETER_MAX_NUMBER
            int "Set the max number of parameter"
            default 8
            help
                The max number of parameter in shell. We support up to eight including command name.
            
        config SHELL_HISTORY_MAX_NUMBER
            int "Set the max number of command history"
            default 5

        config SHELL_PRINT_BUFFER
            int "Set the max number of print buffer"
            default 128
    endmenu

    config SHELL_HELP_SHOW_PERMISSION
        bool "Enable the function of showing permission"
        default y
        help
            Show Command and Variable Permission in Shell

    config SHELL_HELP_LIST_USER
        bool "List all users "
        default n
        help
            List all users in shell

    config SHELL_HELP_LIST_VAR
        bool "List all variable "
        default y
        help
            List all variable in shell

    config SHELL_HELP_LIST_KEY
        bool "List all keys "
        default n
        help
            List all keys in shell

endif

endmenu
```
