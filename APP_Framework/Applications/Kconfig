## APP_Framework/Applications/Kconfig
```kconfig
menu "Applications"

    menu "config stack size and priority of main task"
        config MAIN_KTASK_STACK_SIZE
            int "Set main task stack size"
            default 1024
        config MAIN_KTASK_PRIORITY
            int
            default 4  if KTASK_PRIORITY_8
            default 10  if KTASK_PRIORITY_32
            default 85  if KTASK_PRIORITY_256
    endmenu

    source "$APP_DIR/Applications/app_test/Kconfig"
    source "$APP_DIR/Applications/connection_app/Kconfig"
    source "$APP_DIR/Applications/control_app/Kconfig"
    source "$APP_DIR/Applications/knowing_app/Kconfig"
    source "$APP_DIR/Applications/sensor_app/Kconfig"

endmenu
```

## APP_Framework/Applications/connection_app/Kconfig
```kconfig
menu "connection app"
    menuconfig APPLICATION_CONNECTION
        bool "Using connection apps"
        default n

    menuconfig CONNECTION_COMMUNICATION_ZIGBEE
        bool "enable zigbee demo"
        default n
        select CONFIG_CONNECTION_COMMUNICATION_ZIGBEE
        if CONNECTION_COMMUNICATION_ZIGBEE
            source "$KERNEL_DIR/framework/connection/Adapter/zigbee/Kconfig"
        endif

endmenu
```

## APP_Framework/Applications/control_app/Kconfig
```kconfig
menu "control app"

    menuconfig APPLICATION_CONTROL
        bool "Using control apps"
        default n

endmenu
```

## APP_Framework/Applications/knowing_app/Kconfig
```kconfig
menu "knowing app"

    menuconfig APPLICATION_KNOWING
        bool "Using knowing apps"
        default n

endmenu
```

## APP_Framework/Applications/sensor_app/Kconfig
```kconfig
menu "sensor app"

    menuconfig APPLICATION_SENSOR
        bool "Using sensor apps"
        default n
        select PERCEPTION_SENSORDEVICE

        if APPLICATION_SENSOR
            menuconfig APPLICATION_SENSOR_CO2
                bool "Using sensor CO2 apps"
                default n
                select PERCEPTION_CO2

                if APPLICATION_SENSOR_CO2
                    config APPLICATION_SENSOR_CO2_ZG09
                    bool "Using sensor ZG09 apps"
                    default n
                    select PERCEPTION_ZG09
                endif

            menuconfig APPLICATION_SENSOR_PM1_0
                bool "Using sensor PM1.0 apps"
                default n
                select PERCEPTION_PM

                if APPLICATION_SENSOR_PM1_0
                    config APPLICATION_SENSOR_PM1_0_PS5308
                    bool "Using sensor PS5308 apps"
                    default n
                    select PERCEPTION_PS5308
                endif

            menuconfig APPLICATION_SENSOR_VOICE
                bool "Using sensor voice apps"
                default n
                select PERCEPTION_VOICE

                if APPLICATION_SENSOR_VOICE
                    config APPLICATION_SENSOR_VOICE_D124
                    bool "Using sensor D124 apps"
                    default n
                    select PERCEPTION_D124
                endif

            menuconfig APPLICATION_SENSOR_HUMIDITY
                bool "Using sensor humidity apps"
                default n
                select PERCEPTION_HUMIDITY

                if APPLICATION_SENSOR_HUMIDITY
                    config APPLICATION_SENSOR_HUMIDITY_HS300X
                    bool "Using sensor HS300x apps"
                    default n
                    select PERCEPTION_HS300X
                endif

            menuconfig APPLICATION_SENSOR_TEMPERATURE
                bool "Using sensor temperature apps"
                default n
                select PERCEPTION_TEMPERATURE

                if APPLICATION_SENSOR_TEMPERATURE
                    config APPLICATION_SENSOR_TEMPERATURE_HS300X
                    bool "Using sensor HS300x apps"
                    default n
                    select PERCEPTION_HS300X
                endif
        endif

endmenu
```

## APP_Framework/Framework/Kconfig
```kconfig
config TRANSFORM_LAYER_ATTRIUBUTE
    bool "support transform layer"
    default y
    choice
        prompt "select os features"
        default ADD_XIUOS_FETURES

        config ADD_XIUOS_FETURES
            bool "add xiuos fetures"
        
        config ADD_NUTTX_FETURES
            bool "add nuttx fetures"

        config ADD_RTTHREAD_FETURES
            bool "add rt_thread fetures"
    endchoice


source "$APP_DIR/Framework/sensor/Kconfig"
source "$APP_DIR/Framework/know/tflite_sin/Kconfig"
source "$APP_DIR/Framework/know/tflite_mnist/Kconfig"
```

## APP_Framework/Framework/connection/Kconfig
```kconfig
menuconfig SUPPORT_CONNECTION_FRAMEWORK
        bool "support connection framework"
        default n
```

## APP_Framework/Framework/control/Kconfig
```kconfig
menuconfig SUPPORT_CONTROL_FRAMEWORK
    bool "support control framework"
    default n
```

## APP_Framework/Framework/know/Kconfig
```kconfig
menuconfig SUPPORT_KNOWING_FRAMEWORK
        bool "support knowing framework"
        default y

if SUPPORT_KNOWING_FRAMEWORK
        source "$APP_DIR/Framework/know/tflite_sin/Kconfig"
        source "$APP_DIR/Framework/know/tflite_mnist/Kconfig"
endif
```

## APP_Framework/Framework/know/tflite_sin/Kconfig
```kconfig
menuconfig USING_TFLITE_SIN
    bool "sin(x) demo app for tflite micro"
    depends on INTELLIGENT_TFLITE
    default n
```

## APP_Framework/Framework/sensor/Kconfig
```kconfig
menuconfig SENSOR_SENSORDEVICE
        bool "Using sensor devices"
        default y

if SENSOR_SENSORDEVICE
        menuconfig SENSOR_CO2
                bool "Using CO2 sensor device"
                default n
        if SENSOR_CO2
        source "$APP_DIR/Framework/sensor/co2/Kconfig"
        endif

        menuconfig SENSOR_PM
                bool "Using PM sensor device"
                default n
        if SENSOR_PM
        source "$APP_DIR/Framework/sensor/pm/Kconfig"
        endif

        menuconfig SENSOR_VOICE
                bool "Using voice sensor device"
                default n
        if SENSOR_VOICE
        source "$APP_DIR/Framework/sensor/voice/Kconfig"
        endif

        menuconfig SENSOR_TEMPERATURE
                bool "Using temperature sensor device"
                default n
        if SENSOR_TEMPERATURE
        source "$APP_DIR/Framework/sensor/temperature/Kconfig"
        endif

        menuconfig SENSOR_HUMIDITY
                bool "Using humidity sensor device"
                default n
        if SENSOR_HUMIDITY
        source "$APP_DIR/Framework/sensor/humidity/Kconfig"
        endif
endif
```

## APP_Framework/Framework/sensor/co2/Kconfig
```kconfig
config SENSOR_ZG09
        bool "Using zg09"
        default n

        if SENSOR_ZG09
                config SENSOR_DEVICE_ZG09
                        string "zg09 sensor name"
                        default "zg09_1"
                
                config SENSOR_QUANTITY_ZG09_CO2
                        string "zg09 quantity name"
                        default "co2_1"
                
                config SENSOR_DEVICE_ZG09_DEV
                        string "zg09 device name"
                        default "/dev/uart2_dev2"

                config SENSOR_DEVICE_ZG09_DEV_EXT_PORT
                        int "if ZG09 device using extuart, choose port"
                        default "4"
        endif
```

## APP_Framework/Framework/sensor/pm/Kconfig
```kconfig
config SENSOR_PS5308
        bool "Using PS5308"
        default n

        if SENSOR_PS5308
                config SENSOR_DEVICE_PS5308
                        string "PS5308 sensor name"
                        default "ps5308_1"
                
                config SENSOR_QUANTITY_PS5308_PM1_0
                        string "PS5308 quantity PM1.0 name"
                        default "pm1_0_1"

                config SENSOR_QUANTITY_PS5308_PM2_5
                        string "PS5308 quantity PM2.5 name"
                        default "pm2_5_1"
                
                config SENSOR_QUANTITY_PS5308_PM10
                        string "PS5308 quantity PM10 name"
                        default "pm10_1"
                
                config SENSOR_DEVICE_PS5308_DEV
                        string "PS5308 device name"
                        default "/dev/uart2_dev2"

                config SENSOR_DEVICE_PS5308_DEV_EXT_PORT
                        int "if PS5308 device using extuart, choose port"
                        default "4"
        endif
```

## APP_Framework/Framework/sensor/temperature/Kconfig
```kconfig
config SENSOR_HS300X
        bool "Using HS300x"
        default n

        if SENSOR_HS300X
                config SENSOR_DEVICE_HS300X
                        string "HS300x sensor name"
                        default "hs300x_1"
                
                config SENSOR_QUANTITY_HS300X_TEMPERATURE
                        string "HS300x quantity name"
                        default "temperature_1"
                
                config SENSOR_DEVICE_HS300X_DEV
                        string "HS300x device name"
                        default "/dev/i2c1_dev0"
        endif
```

## APP_Framework/Kconfig
```kconfig
menu "APP_Framework"

    config APP_DIR
        string
        option env="SRC_APP_DIR"
        default "."

source "$APP_DIR/Applications/Kconfig"
source "$APP_DIR/Framework/Kconfig"
source "$APP_DIR/lib/Kconfig"


endmenu
```

## APP_Framework/lib/Kconfig
```kconfig
menu "app lib"

    choice
            prompt "chose a kind of lib for app"
            default APP_SELECT_NEWLIB

            config APP_SELECT_NEWLIB
                bool "app select newlib"
            
            config APP_SELECT_OTHER_LIB
                bool "app select other lib"
    endchoice

endmenu
```

## Ubiquitous/RT_Thread/bsp/k210/Kconfig
```kconfig
mainmenu "XIUOS Rt-thread Configuration"

config ROOT_DIR
    string
    default "../../../.."

config BSP_DIR
    string
    default "."

config RT_Thread_DIR
    string
    default "../.."

config RTT_DIR
    string
    default "../../rt-thread"

config BOARD_K210_EVB
    bool
    select ARCH_RISCV64
    select ARCH_RISCV_FPU_S
    select RT_USING_COMPONENTS_INIT
    select RT_USING_USER_MAIN
    default y

source "$RTT_DIR/Kconfig"
source "base-drivers/Kconfig"
source "kendryte-sdk/Kconfig"
source "$RT_Thread_DIR/drivers/Kconfig"
source "$ROOT_DIR/APP_Framework/Applications/Kconfig"
source "$ROOT_DIR/APP_Framework/Framework/Kconfig"

config __STACKSIZE__
    int "stack size for interrupt"
    default 4096
```

## Ubiquitous/RT_Thread/bsp/k210/base-drivers/Kconfig
```kconfig
menu "Board Drivers Config"

config BSP_USING_UART_HS
    bool "Enable High Speed UART"
    default y


menuconfig BSP_USING_UART1
    bool "Enable UART1"
    default n
    if BSP_USING_UART1
        config BSP_UART1_TXD_PIN
            int "uart1 TXD pin number"
            default 20
        config BSP_UART1_RXD_PIN
            int "uart1 RXD pin number"
            default 21
    endif

menuconfig BSP_USING_UART2
    bool "Enable UART2"
    default n
    if BSP_USING_UART2
        config BSP_UART2_TXD_PIN
            int "uart2 TXD pin number"
            default 28
        config BSP_UART2_RXD_PIN
            int "uart2 RXD pin number"
            default 27
    endif

menuconfig BSP_USING_UART3
    bool "Enable UART3"
    default n
    if BSP_USING_UART3
        config BSP_UART3_TXD_PIN
            int "uart3 TXD pin number"
            default 22
        config BSP_UART3_RXD_PIN
            int "uart3 RXD pin number"
            default 23
    endif

config BSP_USING_I2C1
    bool "Enable I2C1 (GPIO0/1)"
    select RT_USING_I2C
    default n

menuconfig BSP_USING_SPI1
    bool "Enable SPI1"
    select RT_USING_SPI
    default n
if BSP_USING_SPI1
    config BSP_USING_SPI1_AS_QSPI
        bool
        default n
    config BSP_SPI1_CLK_PIN
        int "spi1 clk pin number"
        default 27
    config BSP_SPI1_D0_PIN
        int "spi1 d0 pin number"
        default 28
    config BSP_SPI1_D1_PIN
        int "spi1 d1 pin number"
        default 26
    if BSP_USING_SPI1_AS_QSPI
        config BSP_SPI1_D2_PIN
            int "spi1 d2 pin number"
            default 32
        config BSP_SPI1_D3_PIN
            int "spi1 d3 pin number"
            default 33
    endif
    menuconfig BSP_SPI1_USING_SS0
        bool "SPI1 Enable SS0(spi10 dev)"
        default n
    if BSP_SPI1_USING_SS0
        config BSP_SPI1_SS0_PIN
            int "spi1 ss0 pin number"
            default 29
    endif
    menuconfig BSP_SPI1_USING_SS1
        bool "SPI1 Enable SS1(spi11 dev)"
        default n
    if BSP_SPI1_USING_SS1
        config BSP_SPI1_SS1_PIN
            int "spi1 ss1 pin number"
            default 8
    endif
    menuconfig BSP_SPI1_USING_SS2
        bool "SPI1 Enable SS2(spi12 dev)"
        default n
    if BSP_SPI1_USING_SS2
        config BSP_SPI1_SS2_PIN
            int "spi1 ss2 pin number"
            default 26
    endif
    menuconfig BSP_SPI1_USING_SS3
        bool "SPI1 Enable SS3(spi13 dev)"
        default n
    if BSP_SPI1_USING_SS3
        config BSP_SPI1_SS3_PIN
            int "spi1 ss3 pin number"
            default 27
    endif
endif

menuconfig BSP_USING_LCD
    bool "Enable LCD on SPI0"
    default n

if BSP_USING_LCD
    config BSP_LCD_CS_PIN
        int "CS pin number of 8080 interface"
        default 36
    config BSP_LCD_WR_PIN
        int "WR pin number of 8080 interface"
        default 39
    config BSP_LCD_DC_PIN
        int "DC pin number of 8080 interface"
        default 38
	config BSP_LCD_RST_PIN
        int "RST pin number of 8080 interface"
        default 37
    config BSP_LCD_X_MAX
        int "LCD Height"
        default 240
    config BSP_LCD_Y_MAX
        int "LCD Width"
        default 320
endif

menuconfig BSP_USING_SDCARD
	bool "Enable SDCARD (spi1(ss0))"
	select BSP_USING_SPI1
	select BSP_SPI1_USING_SS0
	select RT_USING_DFS
    select RT_USING_DFS_ELMFAT
	select RT_USING_SPI_MSD
	default n


menuconfig BSP_USING_DVP
    bool "Enable DVP(camera)"
    default n

if BSP_USING_DVP
	comment "The default pin assignment is based on the Maix Duino K210 development board"
    config BSP_DVP_SCCB_SDA_PIN
        int "SCCB SDA pin number for camera"
        default 40
    config BSP_DVP_SCCB_SCLK_PIN
        int "SCCB SCLK pin number for camera"
        default 41
    config BSP_DVP_CMOS_RST_PIN
        int "CMOS RST pin number for camera"
        default 42
    config BSP_DVP_CMOS_VSYNC_PIN
        int "CMOS VSYNC pin number for camera"
        default 43
    config BSP_DVP_CMOS_PWDN_PIN
        int "CMOS PWDN pin number for camera"
        default 44
    config BSP_DVP_CMOS_XCLK_PIN
        int "CMOS XCLK pin number for camera"
        default 46
    config BSP_DVP_CMOS_PCLK_PIN
        int "CMOS PCLK pin number for camera"
        default 47
    config BSP_DVP_CMOS_HREF_PIN
        int "CMOS HREF pin number for camera"
        default 45
endif

if PKG_USING_RW007
    config RW007_SPIDEV_NAME
        string "the SPIDEV rw007 driver on"
        default "spi11"
	config RW007_INT_BUSY_PIN
        int "rw007 int pin for rw007"
        default 7
	config RW007_RST_PIN
        int "rw007 rst pin for rw007"
        default 6
endif	


endmenu
```

## Ubiquitous/RT_Thread/bsp/k210/kendryte-sdk/Kconfig
```kconfig
menu "Kendryte SDK Config"

config PKG_KENDRYTE_SDK_VERNUM
    hex "Kendryte SDK Version"
    default 0x0055

endmenu
```

## Ubiquitous/RT_Thread/bsp/stm32f407-atk-coreboard/Kconfig
```kconfig
mainmenu "RT-Thread Configuration"

config ROOT_DIR
    string
    default "../../../.."

config BSP_DIR
    string
    default "."

config RT_Thread_DIR 
    string
    default "../.."

config RTT_DIR
    string
    default "../../rt-thread"

source "$RTT_DIR/Kconfig"
source "$RTT_DIR/bsp/stm32/libraries/Kconfig"
source "board/Kconfig"
source "$RT_Thread_DIR/drivers/Kconfig"
source "$ROOT_DIR/APP_Framework/Applications/Kconfig"
source "$ROOT_DIR/APP_Framework/Framework/Kconfig"
```
