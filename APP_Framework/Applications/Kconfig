## Ubiquitous/RT_Thread/drivers/Kconfig
```kconfig
menu "More Drivers"

#source "$RT_Thread_DIR/drivers/rw007/Kconfig"
#source "$RT_Thread_DIR/drivers/ov2640/Kconfig"
endmenu
```

## Ubiquitous/RT_Thread/drivers/ov2640/Kconfig
```kconfig
menuconfig DRV_USING_OV2640
	bool "ov2640 driver"
	default n

if SOC_FAMILY_STM32
	config DRV_USING_OV2640
		select BSP_USING_DCMI
endif

if BOARD_K210_EVB
	config DRV_USING_OV2640
		select BSP_USING_DVP
endif
```

## Ubiquitous/RT_Thread/drivers/rw007/Kconfig
```kconfig
menuconfig PKG_USING_RW007
    bool "rw007: SPI WIFI rw007 driver"
    select RT_USING_SPI
    select RT_USING_PIN
    select RT_USING_LWIP
    default n
    help
        if "PKG_USING_RW007" is opened, "RT_USING_LWIP" will be default selected.

if PKG_USING_RW007

    choice
        prompt "example driver port"
        default RW007_USING_STM32_DRIVERS
        config RW007_NOT_USE_EXAMPLE_DRIVERS
            bool "not use example driver, porting by myself"
        config RW007_USING_STM32_DRIVERS
            bool "rw007 for stm32"
        # config RW007_USING_IMXRT_DRIVERS
        #    bool "rw007 for imxrt"
    endchoice

    config RW007_SPI_MAX_HZ
        int "SPI Max Hz"
        default 30000000

    if !RW007_NOT_USE_EXAMPLE_DRIVERS
    if RW007_USING_STM32_DRIVERS || RW007_USING_IMXRT_DRIVERS
        config RW007_SPI_BUS_NAME
            string "RW007 BUS NAME"
            default "spi1"

        config RW007_CS_PIN
            int "CS pin index"
            default 86

    endif

    config RW007_BOOT0_PIN
        int "BOOT0 pin index (same as spi clk pin)"
        default 19

    config RW007_BOOT1_PIN
        int "BOOT1 pin index (same as spi cs pin)"
        default 86

    config RW007_INT_BUSY_PIN
        int "INT/BUSY pin index"
        default 87

    config RW007_RST_PIN
        int "RESET pin index"
        default 88

    endif


endif
```

## Ubiquitous/XiUOS/Kconfig
```kconfig
source "$KERNEL_DIR/kernel/Kconfig"

source "$KERNEL_DIR/lib/Kconfig"

source "$KERNEL_DIR/fs/Kconfig"

source "$KERNEL_DIR/../../APP_Framework/Kconfig"
```
